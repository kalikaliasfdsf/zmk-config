## config/boards/shields/kraken/Kconfig.defconfig
```kconfig
if SHIELD_KRAKEN_LEFT

config ZMK_KEYBOARD_NAME
    default "Kraken"

config ZMK_SPLIT_ROLE_CENTRAL
    default y

endif

if SHIELD_KRAKEN_LEFT || SHIELD_KRAKEN_RIGHT

config ZMK_SPLIT
    default y

endif
```
